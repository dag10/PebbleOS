## fw/services/drew_pin_lock/Kconfig
```kconfig
# SPDX-FileCopyrightText: 2026 Drew Gottlieb
# SPDX-License-Identifier: Apache-2.0

config SERVICE_DREW_PIN_LOCK
    bool "DrewPebbleOS PIN lock"
    help
      DrewPebbleOS: a watch PIN entered on a keypad (touch or buttons), and
      apps that ask for it every time they launch, set up in Settings > PIN Lock.

if SERVICE_DREW_PIN_LOCK

module = SERVICE_DREW_PIN_LOCK
module-str = Drew PIN lock
source "subsys/logging/Kconfig.template.log_level"

endif
```

## fw/services/drew_protocol/Kconfig
```kconfig
# SPDX-FileCopyrightText: 2026 Drew Gottlieb
# SPDX-License-Identifier: Apache-2.0

config SERVICE_DREW_PROTOCOL
    bool "DrewPebbleOS endpoint"
    help
      DrewPebbleOS: the private endpoint (0xde01) DrewMobileApp talks to,
      with hellos that exchange each side's Drew features.

if SERVICE_DREW_PROTOCOL

module = SERVICE_DREW_PROTOCOL
module-str = Drew protocol
source "subsys/logging/Kconfig.template.log_level"

endif
```

## fw/services/drew_updates/Kconfig
```kconfig
# SPDX-FileCopyrightText: 2026 Drew Gottlieb
# SPDX-License-Identifier: Apache-2.0

config SERVICE_DREW_UPDATES
    bool "DrewPebbleOS updates endpoint"
    help
      DrewPebbleOS: lists the updates DrewMobileApp knows about and asks it to
      install one, for Settings > Updates.

if SERVICE_DREW_UPDATES

module = SERVICE_DREW_UPDATES
module-str = Drew updates
source "subsys/logging/Kconfig.template.log_level"

endif
```
